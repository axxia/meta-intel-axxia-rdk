## conf/distro/intel-axxia-indist.conf
```bitbake
require conf/distro/intel-axxia.conf

DISTRO = "intel-axxia-indist"
DISTRO_NAME = "Intel Axxia In-Distribution Distro"
DISTRO_CODENAME = "intel-axxia-indist"

# Variables for each RDK source code archive
RDK_KLM_ARCHIVE = "rdk_klm_src.tar.xz"
RDK_USER_ARCHIVE = "rdk_user_src.tar.xz"
RDK_DPDK_PATCH = "dpdk_diff.patch"

# Autoload RDK kernels (disabled from blacklist.conf)
#KERNEL_MODULE_AUTOLOAD_append_axxiax86-64 = " hqm"
#KERNEL_MODULE_AUTOLOAD_append_axxiax86-64 = " igb"
#KERNEL_MODULE_AUTOLOAD_append_axxiax86-64 = " qat_c4xxx"
#KERNEL_MODULE_AUTOLOAD_append_axxiax86-64 = " intel_qat"
#KERNEL_MODULE_AUTOLOAD_append_axxiax86-64 = " ice_sw"

# Enable RDK-userspace support
#DISTRO_FEATURES_append = " userspace"

# Enable DPDK support (include userspace support)
#DISTRO_FEATURES_append = " dpdk"

COMPATIBLE_MACHINE_pn-dpdk-rdk = \
	"${@bb.utils.contains('DISTRO_FEATURES', 'dpdk', \
			      'axxiax86-64', '', d)}"

COMPATIBLE_MACHINE_pn-dpdk-dev-libibverbs = \
	"${@bb.utils.contains('DISTRO_FEATURES', 'dpdk', \
			      'axxiax86-64', '', d)}"

# Be sure the release version will be used  rdk-user (not dev)
PREFERRED_VERSION_rdk-user ?= "%"

BBMASK_append = "${@bb.utils.contains('DISTRO_FEATURES', 'dpdk', \
				      '', ' dpdk-rdk*', d)} \
		 ${@bb.utils.contains('DISTRO_FEATURES', 'userspace', \
				      '', ' rdk-user*', d)}"
```

## conf/layer.conf
```bitbake
# We have a conf and classes directory, add to BBPATH
BBPATH .= ":${LAYERDIR}"

# We have recipes-* directories, add to BBFILES
BBFILES += "${LAYERDIR}/recipes-*/*/*.bb \
	${LAYERDIR}/recipes-*/*/*.bbappend"

BBFILE_COLLECTIONS += "meta-intel-axxia-rdk"
BBFILE_PATTERN_meta-intel-axxia-rdk = "^${LAYERDIR}/"
BBFILE_PRIORITY_meta-intel-axxia-rdk = "6"

LAYERDEPENDS_meta-intel-axxia-rdk = " \
	intel-axxia \
	dpdk \
"

# Location to populate with the RDK source code archive
RDK_ARCHIVE_PATH = "${LAYERDIR}/downloads"
```
